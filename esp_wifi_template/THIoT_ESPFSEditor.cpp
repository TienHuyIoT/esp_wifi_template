#include <Arduino.h>
#include <FS.h>
#include "THIoT_ESPFSEditor.h"
// #include "THIoT_ESPSDFSClass.h"
#include "THIoT_PFSerialTrace.h"

#define FSEDITOR_DBG_PORT SERIAL_PORT
#if (defined FS_EDITOR_DEBUG) && (FS_EDITOR_DEBUG == 1)
#define FSEDITOR_DBG_PRINTF(...) SERIAL_TAG_LOGI("[FS_EDITOR]", __VA_ARGS__)
#else
#define FSEDITOR_DBG_PRINTF(...)
#endif
/** Convert htm to gzip. Select "Compress this file, output-gz"
 * https://online-converting.com/archives/convert-to-gzip/ 
 * https://peazip.github.io/index.html app PeaZip
 * Convert file to array C
 * http://tomeko.net/online_tools/file_to_hex.php?lang=en
 */

/* File: edit.htm.gz, Size: 4151 */
#define edit_htm_gz_len sizeof(edit_htm_gz)
const uint8_t edit_htm_gz[] PROGMEM = {
0x1F, 0x8B, 0x08, 0x08, 0xC2, 0xB0, 0x45, 0x65, 0x04, 0x00, 0x65, 0x64, 0x69, 0x74, 0x5F, 0x73, 
0x70, 0x69, 0x66, 0x73, 0x2E, 0x68, 0x74, 0x6D, 0x00, 0xD5, 0x1D, 0xFB, 0x7B, 0xDB, 0x34, 0xF0, 
0x77, 0xBE, 0x8F, 0xFF, 0x41, 0x98, 0x47, 0x12, 0x9A, 0x57, 0xBB, 0x52, 0xB6, 0xB4, 0xE9, 0x48, 
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0x0C, 0xFC, 0x1B, 0x77, 0x3C, 0x60, 0x10, 0xA3, 0x70, 0x00, 0x00
};

#define edit_sd_htm_gz_len sizeof(edit_sd_htm_gz)
const uint8_t edit_sd_htm_gz[] PROGMEM = {
0x1F, 0x8B, 0x08, 0x08, 0x86, 0xB0, 0x45, 0x65, 0x04, 0x00, 0x65, 0x64, 0x69, 0x74, 0x5F, 0x73, 
0x64, 0x66, 0x73, 0x2E, 0x68, 0x74, 0x6D, 0x00, 0xD5, 0x1D, 0xFB, 0x7B, 0xDB, 0x34, 0xF0, 0x77, 
0xBE, 0x8F, 0xFF, 0x41, 0x98, 0x47, 0x12, 0x9A, 0x57, 0xBB, 0x52, 0xB6, 0xB4, 0xE9, 0x48, 0xDA, 
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0xBF, 0x70, 0x00, 0x00
};

#define SD_MAXLENGTH_FILEPATH 32
const char *sd_excludeListFile = "/.exclude.files";

typedef struct ExcludeListS {
    char *item;
    ExcludeListS *next;
} ExcludeList;

static ExcludeList *excludes = NULL;

static bool matchWild(const char *pattern, const char *testee) {
  const char *nxPat = NULL, *nxTst = NULL;

  while (*testee) {
    if (( *pattern == '?' ) || (*pattern == *testee)){
      pattern++;testee++;
      continue;
    }
    if (*pattern=='*'){
      nxPat=pattern++; nxTst=testee;
      continue;
    }
    if (nxPat){ 
      pattern = nxPat+1; testee=++nxTst;
      continue;
    }
    return false;
  }
  while (*pattern=='*'){pattern++;}  
  return (*pattern == 0);
}

static bool addExclude(const char *item){
    size_t len = strlen(item);
    if(!len){
        return false;
    }
    ExcludeList *e = (ExcludeList *)malloc(sizeof(ExcludeList));
    if(!e){
        return false;
    }
    e->item = (char *)malloc(len+1);
    if(!e->item){
        free(e);
        return false;
    }
    memcpy(e->item, item, len+1);
    e->next = excludes;
    excludes = e;
    return true;
}

static void loadExcludeList(FS &_fs, const char *filename){
    static char linebuf[SD_MAXLENGTH_FILEPATH];
    fs::File excludeFile=_fs.open(filename, "r");
    if(!excludeFile){
        //addExclude("/*.js.gz");
        return;
    }
#ifdef ESP32
    if(excludeFile.isDirectory()){
      excludeFile.close();
      return;
    }
#endif
    if (excludeFile.size() > 0){
      uint8_t idx;
      bool isOverflowed = false;
      while (excludeFile.available()){
        linebuf[0] = '\0';
        idx = 0;
        int lastChar;
        do {
          lastChar = excludeFile.read();
          if(lastChar != '\r'){
            linebuf[idx++] = (char) lastChar;
          }
        } while ((lastChar >= 0) && (lastChar != '\n') && (idx < SD_MAXLENGTH_FILEPATH));

        if(isOverflowed){
          isOverflowed = (lastChar != '\n');
          continue;
        }
        isOverflowed = (idx >= SD_MAXLENGTH_FILEPATH);
        linebuf[idx-1] = '\0';
        if(!addExclude(linebuf)){
            excludeFile.close();
            return;
        }
      }
    }
    excludeFile.close();
}

static bool isExcluded(FS &_fs, const char *filename) {
  if(excludes == NULL){
      loadExcludeList(_fs, sd_excludeListFile);
  }
  ExcludeList *e = excludes;
  while(e){
    if (matchWild(e->item, filename)){
      return true;
    }
    e = e->next;
  }
  return false;
}

// WEB HANDLER IMPLEMENTATION

ESPFSEditor::ESPFSEditor(const FS& fs, const int fsType, const String& username, const String& password)
:_fs(fs)
,_username(username)
,_password(password)
,_authenticated(false)
,_startTime(0)
,_filesize(0)
,_progress(0)
,_progress_callback(NULL)
,_status_callback(NULL)
{
  if(FS_EDITOR_SD_TYPE == fsType)
  {
    _uri = "/edit_sdfs";
    _edit_htm = (uint8_t*)edit_sd_htm_gz;
    _size_htm = edit_sd_htm_gz_len;
  }
  else
  {
    _uri = "/edit";
    _edit_htm = (uint8_t*)edit_htm_gz;
    _size_htm = edit_htm_gz_len;
  }
}

ESPFSEditor& ESPFSEditor::onProgress(THandlerFunction_Progress fn) {
    _progress_callback = fn;
    return *this;
}

ESPFSEditor& ESPFSEditor::onStatus(fs_status fn)
{
  _status_callback = fn;
  return *this;
}

bool ESPFSEditor::canHandle(AsyncWebServerRequest *request){ 
  if(request->url().equalsIgnoreCase(_uri)){
    String path = "";
#if (defined FS_EDITOR_DEBUG) && (FS_EDITOR_DEBUG == 1)
    FSEDITOR_DBG_PRINTF("canHandle");
    debug(request);
#endif
    if(request->method() == HTTP_GET){
      if(request->hasParam("list"))
        return true;
      if(request->hasParam("status"))
        return true;
      if(request->hasParam("edit")){
        path = request->arg("edit");
#if defined(ESP32) && ESP_IDF_VERSION_MAJOR >= 4
        if (!path.startsWith("/"))
        {
          path = "/" + path;
        }
#endif
        request->_tempFile = _fs.open(path, "r");
        if(!request->_tempFile){
          return false;
        }
#ifdef ESP32
        if(request->_tempFile.isDirectory()){
          request->_tempFile.close();
          return false;
        }
#endif
      }
      if(request->hasParam("download")){
        path = request->arg("download");
#if defined(ESP32) && ESP_IDF_VERSION_MAJOR >= 4
        if (!path.startsWith("/"))
        {
          path = "/" + path;
        }
#endif
        request->_tempFile = _fs.open(path, "r");
        if(!request->_tempFile){
          return false;
        }
#ifdef ESP32
        if(request->_tempFile.isDirectory()){
          request->_tempFile.close();
          return false;
        }
#endif
      }
      request->addInterestingHeader("If-Modified-Since");
      return true;
    }
    else if(request->method() == HTTP_POST)
    {
      _progress = 0;
      _filesize = request->contentLength();
      return true;
    }      
    else if(request->method() == HTTP_DELETE)
      return true;
    else if(request->method() == HTTP_PUT)
      return true;

  }
  return false;
}


void ESPFSEditor::handleRequest(AsyncWebServerRequest *request){
  String path = "";
  if(_username.length() && _password.length())
  {
    if(!request->authenticate(_username.c_str(), _password.c_str()))
    {
      return request->requestAuthentication();
    } 
  }     
  else
  {
    if(_onAuthenticate)
    {
      if(!_onAuthenticate(request))
      {
        return;
      }
    }
  }

#if (defined FS_EDITOR_DEBUG) && (FS_EDITOR_DEBUG == 1)
  FSEDITOR_DBG_PRINTF("handleRequest");
  debug(request);
#endif

  if(request->method() == HTTP_GET){
    if(request->hasParam("list")){
      String path = request->getParam("list")->value();
#ifdef ESP32
      File dir = _fs.open(path);
#else
      Dir dir = _fs.openDir(path);
#endif
      path = String();
      String output = "[";
#ifdef ESP32
      File entry = dir.openNextFile();
      while(entry){
#else
      while(dir.next()){
        fs::File entry = dir.openFile("r");
#endif
        if (isExcluded(_fs, entry.name()))
        {
#ifdef ESP32
            entry = dir.openNextFile();
#endif
            continue;
        }
        if (output != "[") output += ',';
        output += "{\"type\":\"";
        output += "file";
        output += "\",\"name\":\"";
        output += String(entry.name());
        output += "\",\"size\":";
        output += String(entry.size());
        output += "}";
#ifdef ESP32
        entry = dir.openNextFile();
#else
        entry.close();
#endif
      }
#ifdef ESP32
      dir.close();
#endif
      output += "]";
      request->send(200, "application/json", output);
      FSEDITOR_DBG_PRINTF("[list] %s", output.c_str());
      output = String();
    }
    else if(request->hasParam("status"))
    {
      if(_status_callback)
      {
        _status_callback(request);
      }
      else
      {
        request->send(200, "application/json", "");
      }
    }
    else if(request->hasParam("edit") || request->hasParam("download")){
      String name;
      if (request->hasParam("filename"))
      {
        name = request->arg("filename");
      }
      else
      {
        name = request->_tempFile.name();
      }
      request->send(request->_tempFile, name, String(), request->hasParam("download"));
    }
    else {
      const char * buildTime = __DATE__ " " __TIME__ " GMT";
      if (request->header("If-Modified-Since").equals(buildTime)) {
        request->send(304);
      } else {
        AsyncWebServerResponse *response = request->beginResponse_P(200, "text/html", _edit_htm, _size_htm);
        response->addHeader("Content-Encoding", "gzip");
        response->addHeader("Last-Modified", buildTime);
        request->send(response);
      }
    }
  } else if(request->method() == HTTP_DELETE){
    if(request->hasParam("path", true)){
      path = request->getParam("path", true)->value();
#if defined(ESP32) && ESP_IDF_VERSION_MAJOR >= 4
      if (!path.startsWith("/"))
      {
        path = "/" + path;
      }
#endif
      _fs.remove(path);
      request->send(200, "", "DELETE: " + request->getParam("path", true)->value());
    } else
      request->send(404);
  } else if(request->method() == HTTP_POST){
      path = request->getParam("data", true, true)->value();
#if defined(ESP32) && ESP_IDF_VERSION_MAJOR >= 4
      if (!path.startsWith("/"))
      {
        path = "/" + path;
      }
#endif
    bool exist = _fs.exists(path);
    FSEDITOR_DBG_PRINTF("Exist(%u)", exist);
    if(request->hasParam("data", true, true) && exist)
    {
      FSEDITOR_DBG_PRINTF("UPLOADED");
      request->send(200, "", "UPLOADED: " + request->getParam("data", true, true)->value());
    }
    else
      request->send(500);
  } else if(request->method() == HTTP_PUT){
    if(request->hasParam("path", true)){
      path = request->getParam("path", true)->value();
#if defined(ESP32) && ESP_IDF_VERSION_MAJOR >= 4
      if (!path.startsWith("/"))
      {
        path = "/" + path;
      }
#endif
      if(_fs.exists(path)){
        request->send(200);
      } else {
        fs::File f = _fs.open(path, "w");
        if(f){
          f.write((uint8_t)0x00);
          f.close();
          request->send(200, "", "CREATE: " + request->getParam("path", true)->value());
        } else {
          request->send(500);
        }
      }
    } else
      request->send(400);
  }
}

void ESPFSEditor::handleUpload(AsyncWebServerRequest *request, const String& filename, size_t index, uint8_t *data, size_t len, bool final){
  if(!index){
    if(!_username.length() || request->authenticate(_username.c_str(),_password.c_str())){
      _authenticated = true;    
      String path = filename;
#if defined(ESP32) && ESP_IDF_VERSION_MAJOR >= 4
      if (!path.startsWith("/"))
      {
        path = "/" + path;
      }
#endif  
      request->_tempFile = _fs.open(path, "w");
      _startTime = millis();
#if (defined FS_EDITOR_DEBUG) && (FS_EDITOR_DEBUG == 1)
      FSEDITOR_DBG_PRINTF("Start file upload (%u)ms", _startTime);
#endif
    }
  }
  if(_authenticated && request->_tempFile){
    if(len){
      request->_tempFile.write(data,len);
      _progress += len;
      _progress_callback(_progress, _filesize);
#if (defined FS_EDITOR_DEBUG) && (FS_EDITOR_DEBUG == 1)
      FSEDITOR_DBG_PRINTF("Write %u%% (%u/%u)", _progress * 100 / _filesize, _progress, _filesize);
#endif      
    }
    if(final){
      request->_tempFile.close();
      _progress_callback(_filesize, _filesize);
#if (defined FS_EDITOR_DEBUG) && (FS_EDITOR_DEBUG == 1)
      FSEDITOR_DBG_PRINTF("Finish file upload time = %u(ms)", millis() - _startTime);
#endif
    }
  }
}

void ESPFSEditor::debug(AsyncWebServerRequest *request) {
  if(request->method() == HTTP_GET)
    FSEDITOR_DBG_PRINTF("GET");
  else if(request->method() == HTTP_POST)
    FSEDITOR_DBG_PRINTF("POST");
  else if(request->method() == HTTP_DELETE)
    FSEDITOR_DBG_PRINTF("DELETE");
  else if(request->method() == HTTP_PUT)
    FSEDITOR_DBG_PRINTF("PUT");
  else if(request->method() == HTTP_PATCH)
    FSEDITOR_DBG_PRINTF("PATCH");
  else if(request->method() == HTTP_HEAD)
    FSEDITOR_DBG_PRINTF("HEAD");
  else if(request->method() == HTTP_OPTIONS)
    FSEDITOR_DBG_PRINTF("OPTIONS");
  else
    FSEDITOR_DBG_PRINTF("UNKNOWN");
  FSEDITOR_DBG_PRINTF(" http://%s%s\n", request->host().c_str(), request->url().c_str());

  if(request->contentLength()){
    FSEDITOR_DBG_PRINTF("_CONTENT_TYPE: %s\n", request->contentType().c_str());
    FSEDITOR_DBG_PRINTF("_CONTENT_LENGTH: %u\n", request->contentLength());
  }

  int headers = request->headers();
  int i;
  for(i=0;i<headers;i++){
    AsyncWebHeader* h = request->getHeader(i);
    FSEDITOR_DBG_PRINTF("_HEADER[%s]: %s\n", h->name().c_str(), h->value().c_str());
  }

  int params = request->params();
  for(i=0;i<params;i++){
    AsyncWebParameter* p = request->getParam(i);
    if(p->isFile()){
      FSEDITOR_DBG_PRINTF("_FILE[%s]: %s, size: %u\n", p->name().c_str(), p->value().c_str(), p->size());
    } else if(p->isPost()){
      FSEDITOR_DBG_PRINTF("_POST[%s]: %s\n", p->name().c_str(), p->value().c_str());
    } else {
      FSEDITOR_DBG_PRINTF("_GET[%s]: %s\n", p->name().c_str(), p->value().c_str());
    }
  }
}
