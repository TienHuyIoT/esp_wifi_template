#include <Arduino.h>
#include <FS.h>
#include "fs_editor.h"

#define FSEDITOR_DBG_PORT Serial
#if (defined FS_EDITOR_DEBUG) && (FS_EDITOR_DEBUG == 1)
#define FSEDITOR_DBG_PRINTF(f_, ...) FSEDITOR_DBG_PORT.printf_P(PSTR("\r\n[FS_EDITOR] " f_), ##__VA_ARGS__)
#else
#define FSEDITOR_DBG_PRINTF(f_, ...)
#endif
/* Convert htm to gzip. Select "Compress this file, output-gz"
 * https://online-converting.com/archives/convert-to-gzip/ 
 * Convert file to array C
 * http://tomeko.net/online_tools/file_to_hex.php?lang=en
 */

/* File: edit.htm.gz, Size: 4151 */
#define edit_htm_gz_len sizeof(edit_htm_gz)
const uint8_t edit_htm_gz[] PROGMEM = {
 0x1F, 0x8B, 0x08, 0x08, 0xB8, 0x94, 0xB1, 0x59, 0x00, 0x03, 0x65, 0x64, 0x69, 0x74, 0x2E, 0x68,
 0x74, 0x6D, 0x00, 0xB5, 0x3A, 0x0B, 0x7B, 0xDA, 0xB8, 0xB2, 0x7F, 0xC5, 0x71, 0xCF, 0x66, 0xED,
 0x83, 0x31, 0x90, 0xA4, 0xD9, 0xD6, 0xC4, 0xC9, 0x42, 0x92, 0x36, 0x6D, 0xF3, 0x6A, 0x80, 0xB6,
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 0xE8, 0x9D, 0x36, 0x92, 0x29, 0x00, 0x00
};

#define edit_sd_htm_gz_len sizeof(edit_sd_htm_gz)
const uint8_t edit_sd_htm_gz[] PROGMEM = {
0x1F, 0x8B, 0x08, 0x08, 0x5D, 0x3A, 0xB0, 0x5F, 0x00, 0x03, 0x65, 0x64, 0x69, 0x74, 0x5F, 0x73, 
0x64, 0x66, 0x73, 0x2E, 0x68, 0x74, 0x6D, 0x00, 0xD5, 0x3D, 0x69, 0x7B, 0x9B, 0x48, 0xD2, 0xDF, 
0xE7, 0x57, 0x10, 0xB2, 0x13, 0xC9, 0x63, 0x5D, 0x3E, 0xE2, 0xCD, 0x28, 0x76, 0xB2, 0x92, 0xEC, 
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0x82, 0x62, 0x00, 0x00
};

#define SD_MAXLENGTH_FILEPATH 32
const char *sd_excludeListFile = "/.exclude.files";

typedef struct ExcludeListS {
    char *item;
    ExcludeListS *next;
} ExcludeList;

static ExcludeList *excludes = NULL;

static bool matchWild(const char *pattern, const char *testee) {
  const char *nxPat = NULL, *nxTst = NULL;

  while (*testee) {
    if (( *pattern == '?' ) || (*pattern == *testee)){
      pattern++;testee++;
      continue;
    }
    if (*pattern=='*'){
      nxPat=pattern++; nxTst=testee;
      continue;
    }
    if (nxPat){ 
      pattern = nxPat+1; testee=++nxTst;
      continue;
    }
    return false;
  }
  while (*pattern=='*'){pattern++;}  
  return (*pattern == 0);
}

static bool addExclude(const char *item){
    size_t len = strlen(item);
    if(!len){
        return false;
    }
    ExcludeList *e = (ExcludeList *)malloc(sizeof(ExcludeList));
    if(!e){
        return false;
    }
    e->item = (char *)malloc(len+1);
    if(!e->item){
        free(e);
        return false;
    }
    memcpy(e->item, item, len+1);
    e->next = excludes;
    excludes = e;
    return true;
}

static void loadExcludeList(fs::FS &_fs, const char *filename){
    static char linebuf[SD_MAXLENGTH_FILEPATH];
    fs::File excludeFile=_fs.open(filename, "r");
    if(!excludeFile){
        //addExclude("/*.js.gz");
        return;
    }
#ifdef ESP32
    if(excludeFile.isDirectory()){
      excludeFile.close();
      return;
    }
#endif
    if (excludeFile.size() > 0){
      uint8_t idx;
      bool isOverflowed = false;
      while (excludeFile.available()){
        linebuf[0] = '\0';
        idx = 0;
        int lastChar;
        do {
          lastChar = excludeFile.read();
          if(lastChar != '\r'){
            linebuf[idx++] = (char) lastChar;
          }
        } while ((lastChar >= 0) && (lastChar != '\n') && (idx < SD_MAXLENGTH_FILEPATH));

        if(isOverflowed){
          isOverflowed = (lastChar != '\n');
          continue;
        }
        isOverflowed = (idx >= SD_MAXLENGTH_FILEPATH);
        linebuf[idx-1] = '\0';
        if(!addExclude(linebuf)){
            excludeFile.close();
            return;
        }
      }
    }
    excludeFile.close();
}

static bool isExcluded(fs::FS &_fs, const char *filename) {
  if(excludes == NULL){
      loadExcludeList(_fs, sd_excludeListFile);
  }
  ExcludeList *e = excludes;
  while(e){
    if (matchWild(e->item, filename)){
      return true;
    }
    e = e->next;
  }
  return false;
}

// WEB HANDLER IMPLEMENTATION

#ifdef ESP32
FSEditor::FSEditor(const fs::FS& fs, const String& uri, const String& username, const String& password)
#else
FSEditor::FSEditor(const String& username, const String& password, const fs::FS& fs, const String& uri)
#endif
:_fs(fs)
,_username(username)
,_password(password)
,_authenticated(false)
,_startTime(0)
,_filesize(0)
,_progress(0)
,_progress_callback(NULL)
,_uri(uri)
,_status_callback(NULL)
{
  if(_uri == "/edit_sdfs")
  {
    _edit_htm = (uint8_t*)edit_sd_htm_gz;
    _size_htm = edit_sd_htm_gz_len;
  }
  else
  {
    _uri == "/edit";
    _edit_htm = (uint8_t*)edit_htm_gz;
    _size_htm = edit_htm_gz_len;
  }
}

FSEditor& FSEditor::onProgress(THandlerFunction_Progress fn) {
    _progress_callback = fn;
    return *this;
}

FSEditor& FSEditor::onStatus(fs_status fn)
{
  _status_callback = fn;
  return *this;
}

bool FSEditor::canHandle(AsyncWebServerRequest *request){  
  if(request->url().equalsIgnoreCase(_uri)){
#if (defined FS_EDITOR_DEBUG) && (FS_EDITOR_DEBUG == 1)
    FSEDITOR_DBG_PRINTF("canHandle");
    debug(request);
#endif
    if(request->method() == HTTP_GET){
      if(request->hasParam("list"))
        return true;
      if(request->hasParam("status"))
        return true;
      if(request->hasParam("edit")){
        request->_tempFile = _fs.open(request->arg("edit"), "r");
        if(!request->_tempFile){
          return false;
        }
#ifdef ESP32
        if(request->_tempFile.isDirectory()){
          request->_tempFile.close();
          return false;
        }
#endif
      }
      if(request->hasParam("download")){
        request->_tempFile = _fs.open(request->arg("download"), "r");
        if(!request->_tempFile){
          return false;
        }
#ifdef ESP32
        if(request->_tempFile.isDirectory()){
          request->_tempFile.close();
          return false;
        }
#endif
      }
      request->addInterestingHeader("If-Modified-Since");
      return true;
    }
    else if(request->method() == HTTP_POST)
    {
      _progress = 0;
      _filesize = request->contentLength();
      return true;
    }      
    else if(request->method() == HTTP_DELETE)
      return true;
    else if(request->method() == HTTP_PUT)
      return true;

  }
  return false;
}


void FSEditor::handleRequest(AsyncWebServerRequest *request){
  if(_username.length() && _password.length() && !request->authenticate(_username.c_str(), _password.c_str()))
    return request->requestAuthentication();

#if (defined FS_EDITOR_DEBUG) && (FS_EDITOR_DEBUG == 1)
  FSEDITOR_DBG_PRINTF("handleRequest");
  debug(request);
#endif

  if(request->method() == HTTP_GET){
    if(request->hasParam("list")){
      String path = request->getParam("list")->value();
#ifdef ESP32
      File dir = _fs.open(path);
#else
      Dir dir = _fs.openDir(path);
#endif
      path = String();
      String output = "[";
#ifdef ESP32
      File entry = dir.openNextFile();
      while(entry){
#else
      while(dir.next()){
        fs::File entry = dir.openFile("r");
#endif
        if (isExcluded(_fs, entry.name())) {
#ifdef ESP32
            entry = dir.openNextFile();
#endif
            continue;
        }
        if (output != "[") output += ',';
        output += "{\"type\":\"";
        output += "file";
        output += "\",\"name\":\"";
        output += String(entry.name());
        output += "\",\"size\":";
        output += String(entry.size());
        output += "}";
#ifdef ESP32
        entry = dir.openNextFile();
#else
        entry.close();
#endif
      }
#ifdef ESP32
      dir.close();
#endif
      output += "]";
      request->send(200, "application/json", output);
      output = String();
    }
    else if(request->hasParam("status"))
    {
      if(_status_callback)
      {
        _status_callback(request);
      }
      else
      {
        request->send(200, "application/json", "");
      }
    }
    else if(request->hasParam("edit") || request->hasParam("download")){
      request->send(request->_tempFile, request->_tempFile.name(), String(), request->hasParam("download"));
    }
    else {
      const char * buildTime = __DATE__ " " __TIME__ " GMT";
      if (request->header("If-Modified-Since").equals(buildTime)) {
        request->send(304);
      } else {
        AsyncWebServerResponse *response = request->beginResponse_P(200, "text/html", _edit_htm, _size_htm);
        response->addHeader("Content-Encoding", "gzip");
        response->addHeader("Last-Modified", buildTime);
        request->send(response);
      }
    }
  } else if(request->method() == HTTP_DELETE){
    if(request->hasParam("path", true)){
        _fs.remove(request->getParam("path", true)->value());
      request->send(200, "", "DELETE: "+request->getParam("path", true)->value());
    } else
      request->send(404);
  } else if(request->method() == HTTP_POST){
    bool exist = _fs.exists(request->getParam("data", true, true)->value());
    FSEDITOR_DBG_PRINTF("Exist(%u)", exist);
    if(request->hasParam("data", true, true) && exist)
    {
      FSEDITOR_DBG_PRINTF("UPLOADED");
      request->send(200, "", "UPLOADED: "+request->getParam("data", true, true)->value());
    }
    else
      request->send(500);
  } else if(request->method() == HTTP_PUT){
    if(request->hasParam("path", true)){
      String filename = request->getParam("path", true)->value();
      if(_fs.exists(filename)){
        request->send(200);
      } else {
        fs::File f = _fs.open(filename, "w");
        if(f){
          f.write((uint8_t)0x00);
          f.close();
          request->send(200, "", "CREATE: "+filename);
        } else {
          request->send(500);
        }
      }
    } else
      request->send(400);
  }
}

void FSEditor::handleUpload(AsyncWebServerRequest *request, const String& filename, size_t index, uint8_t *data, size_t len, bool final){
  if(!index){
    if(!_username.length() || request->authenticate(_username.c_str(),_password.c_str())){
      _authenticated = true;      
      request->_tempFile = _fs.open(filename, "w");
      _startTime = millis();
#if (defined FS_EDITOR_DEBUG) && (FS_EDITOR_DEBUG == 1)
      FSEDITOR_DBG_PRINTF("Start file upload (%u)", _startTime);
#endif
    }
  }
  if(_authenticated && request->_tempFile){
    if(len){
      request->_tempFile.write(data,len);
      _progress += len;
      _progress_callback(_progress, _filesize);
#if (defined FS_EDITOR_DEBUG) && (FS_EDITOR_DEBUG == 1)
      FSEDITOR_DBG_PRINTF("Write %u%% (%u/%u)", _progress * 100 / _filesize, _progress, _filesize);
#endif      
    }
    if(final){
      request->_tempFile.close();
      _progress_callback(_filesize, _filesize);
#if (defined FS_EDITOR_DEBUG) && (FS_EDITOR_DEBUG == 1)
      FSEDITOR_DBG_PRINTF("Finish file upload time = %u(ms)", millis() - _startTime);
#endif
    }
  }
}

void FSEditor::debug(AsyncWebServerRequest *request) {
  if(request->method() == HTTP_GET)
    FSEDITOR_DBG_PRINTF("GET");
  else if(request->method() == HTTP_POST)
    FSEDITOR_DBG_PRINTF("POST");
  else if(request->method() == HTTP_DELETE)
    FSEDITOR_DBG_PRINTF("DELETE");
  else if(request->method() == HTTP_PUT)
    FSEDITOR_DBG_PRINTF("PUT");
  else if(request->method() == HTTP_PATCH)
    FSEDITOR_DBG_PRINTF("PATCH");
  else if(request->method() == HTTP_HEAD)
    FSEDITOR_DBG_PRINTF("HEAD");
  else if(request->method() == HTTP_OPTIONS)
    FSEDITOR_DBG_PRINTF("OPTIONS");
  else
    FSEDITOR_DBG_PRINTF("UNKNOWN");
  FSEDITOR_DBG_PRINTF(" http://%s%s\n", request->host().c_str(), request->url().c_str());

  if(request->contentLength()){
    FSEDITOR_DBG_PRINTF("_CONTENT_TYPE: %s\n", request->contentType().c_str());
    FSEDITOR_DBG_PRINTF("_CONTENT_LENGTH: %u\n", request->contentLength());
  }

  int headers = request->headers();
  int i;
  for(i=0;i<headers;i++){
    AsyncWebHeader* h = request->getHeader(i);
    FSEDITOR_DBG_PRINTF("_HEADER[%s]: %s\n", h->name().c_str(), h->value().c_str());
  }

  int params = request->params();
  for(i=0;i<params;i++){
    AsyncWebParameter* p = request->getParam(i);
    if(p->isFile()){
      FSEDITOR_DBG_PRINTF("_FILE[%s]: %s, size: %u\n", p->name().c_str(), p->value().c_str(), p->size());
    } else if(p->isPost()){
      FSEDITOR_DBG_PRINTF("_POST[%s]: %s\n", p->name().c_str(), p->value().c_str());
    } else {
      FSEDITOR_DBG_PRINTF("_GET[%s]: %s\n", p->name().c_str(), p->value().c_str());
    }
  }
}
